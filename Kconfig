## Kconfig
```kconfig
menu "TraceKit"

    choice TRACEKIT_LOG_LEVEL_CHOICE
        prompt "Log level of the tracekit.* tags"
        default TRACEKIT_LOG_LEVEL_INFO
        help
            Applied by TraceKit::begin() to every tracekit.* tag with
            esp_log_level_set(). It cannot go above the project-wide
            CONFIG_LOG_MAXIMUM_LEVEL. Change a single tag at runtime with
            esp_log_level_set("tracekit.tcp", ESP_LOG_DEBUG).

        config TRACEKIT_LOG_LEVEL_NONE
            bool "No output"
        config TRACEKIT_LOG_LEVEL_ERROR
            bool "Error"
        config TRACEKIT_LOG_LEVEL_WARN
            bool "Warning"
        config TRACEKIT_LOG_LEVEL_INFO
            bool "Info"
        config TRACEKIT_LOG_LEVEL_DEBUG
            bool "Debug"
        config TRACEKIT_LOG_LEVEL_VERBOSE
            bool "Verbose"
    endchoice

    config TRACEKIT_LOG_LEVEL
        int
        default 0 if TRACEKIT_LOG_LEVEL_NONE
        default 1 if TRACEKIT_LOG_LEVEL_ERROR
        default 2 if TRACEKIT_LOG_LEVEL_WARN
        default 3 if TRACEKIT_LOG_LEVEL_INFO
        default 4 if TRACEKIT_LOG_LEVEL_DEBUG
        default 5 if TRACEKIT_LOG_LEVEL_VERBOSE

    menu "Links"
        help
            A link that is compiled out cannot be selected at runtime:
            begin() falls back to Serial (TRACEKIT_ERR_LINK_UNSUPPORTED).

        config TRACEKIT_LINK_SERIAL
            bool "Serial (native USB CDC or UART)"
            default y
            help
                DeviceConfig::serial_port picks the port: the native USB
                (TinyUSB CDC, ESP32-S2/S3/P4) or a UART, usually the one
                behind the board's USB-serial bridge.

        config TRACEKIT_LINK_TCP
            bool "TCP over Wi-Fi"
            default y

        config TRACEKIT_LINK_BLE
            bool "Bluetooth LE (needs NimBLE enabled in the Bluetooth menu)"
            depends on BT_NIMBLE_ENABLED
            default y

        config TRACEKIT_LINK_ESPNOW
            bool "ESP-NOW (through the bally_dongle)"
            default y

        config TRACEKIT_INSECURE_CLEARTEXT_RADIO
            bool "DEVELOPMENT ONLY: let TCP/BLE/ESP-NOW run without the device key"
            default n
            help
                Without a provisioned key, TCP, BLE and ESP-NOW refuse to start
                and the device falls back to Serial (anyone in radio range could
                read and command it otherwise). This lets them run in clear text
                for bench tests before a key is provisioned. Never ship it: the
                boot log warns every time.
    endmenu

endmenu
```

## recovery/main/Kconfig.projbuild
```kconfig
menu "BTPDevice recovery"

    config BTPDEV_RECOVERY_TIMEOUT_MIN
        int "Minutes without an upload before going back to the application"
        default 10
        range 1 1440
        help
            Only when entered by `btp -recovery`. After a crash loop or a
            factory reset the recovery waits for a firmware (docs/PLANO.md D25).

    config BTPDEV_RECOVERY_AP
        bool "Own Wi-Fi network when no known network answers"
        default y
        select ESP_WIFI_SOFTAP_SUPPORT
        help
            With no network mirrored by the application, or after every known
            network failed once, the recovery also raises "btp-<name>" and
            serves its page at http://192.168.4.1/ (a phone opens it by
            itself: captive portal). Uploads stay authenticated by the key.
            Costs about 50 KB.

    config BTPDEV_RECOVERY_AP_PASSWORD
        string "Password of the own network (empty: open network)"
        default ""
        depends on BTPDEV_RECOVERY_AP
        help
            8 to 63 characters for WPA2. The upload is signed with the key
            either way; this only keeps strangers off the network.

    config BTPDEV_RECOVERY_INSECURE
        bool "DEVELOPMENT ONLY: accept uploads without the device key"
        default n
        help
            Without a key in NVS the recovery refuses every upload. This lets
            it accept them unauthenticated, for a bench before a key is
            provisioned. Anyone on the network can then flash the device.
endmenu
```
