## Kconfig
```kconfig
menu "BTPDevice"

    choice BTPDEV_LOG_LEVEL_CHOICE
        prompt "Log level of the btpdev.* tags"
        default BTPDEV_LOG_LEVEL_INFO
        help
            Applied by BtpDevice::begin() to every btpdev.* tag with
            esp_log_level_set(). It cannot go above the project-wide
            CONFIG_LOG_MAXIMUM_LEVEL. Change a single tag at runtime with
            esp_log_level_set("btpdev.tcp", ESP_LOG_DEBUG).

        config BTPDEV_LOG_LEVEL_NONE
            bool "No output"
        config BTPDEV_LOG_LEVEL_ERROR
            bool "Error"
        config BTPDEV_LOG_LEVEL_WARN
            bool "Warning"
        config BTPDEV_LOG_LEVEL_INFO
            bool "Info"
        config BTPDEV_LOG_LEVEL_DEBUG
            bool "Debug"
        config BTPDEV_LOG_LEVEL_VERBOSE
            bool "Verbose"
    endchoice

    config BTPDEV_LOG_LEVEL
        int
        default 0 if BTPDEV_LOG_LEVEL_NONE
        default 1 if BTPDEV_LOG_LEVEL_ERROR
        default 2 if BTPDEV_LOG_LEVEL_WARN
        default 3 if BTPDEV_LOG_LEVEL_INFO
        default 4 if BTPDEV_LOG_LEVEL_DEBUG
        default 5 if BTPDEV_LOG_LEVEL_VERBOSE

    menu "Links"
        help
            A link that is compiled out cannot be selected at runtime:
            begin() falls back to Serial (BTPDEV_ERR_LINK_UNSUPPORTED).

        config BTPDEV_LINK_SERIAL
            bool "Serial (USB CDC)"
            default y

        config BTPDEV_LINK_TCP
            bool "TCP over Wi-Fi"
            default y

        config BTPDEV_LINK_BLE
            bool "Bluetooth LE (needs NimBLE enabled in the Bluetooth menu)"
            depends on BT_NIMBLE_ENABLED
            default y

        config BTPDEV_LINK_ESPNOW
            bool "ESP-NOW (through the bally_dongle)"
            default y

        config BTPDEV_INSECURE_CLEARTEXT_RADIO
            bool "DEVELOPMENT ONLY: let TCP/BLE/ESP-NOW run without the device key"
            default n
            help
                Without a provisioned key, TCP, BLE and ESP-NOW refuse to start
                and the device falls back to Serial (anyone in radio range could
                read and command it otherwise). This lets them run in clear text
                for bench tests before a key is provisioned. Never ship it: the
                boot log warns every time.
    endmenu

endmenu
```

## examples/04_ble_secure/sdkconfig.defaults
```kconfig
CONFIG_ESP_CONSOLE_UART_DEFAULT=y
CONFIG_PARTITION_TABLE_CUSTOM=y
CONFIG_PARTITION_TABLE_CUSTOM_FILENAME="partitions.csv"
CONFIG_ESPTOOLPY_FLASHSIZE_8MB=y
CONFIG_BT_ENABLED=y
CONFIG_BT_NIMBLE_ENABLED=y
CONFIG_BT_NIMBLE_ATT_PREFERRED_MTU=517
```

## test_apps/link_echo/main/Kconfig.projbuild
```kconfig
menu "Link echo"

    choice ECHO_LINK
        prompt "Link under test"
        default ECHO_LINK_SERIAL
        config ECHO_LINK_SERIAL
            bool "Serial (USB CDC)"
        config ECHO_LINK_TCP
            bool "TCP (Wi-Fi)"
        config ECHO_LINK_BLE
            bool "BLE"
        config ECHO_LINK_ESPNOW
            bool "ESP-NOW"
    endchoice

    config ECHO_DEVICE_NAME
        string "Device name (USB, BLE, mDNS)"
        default "btpdev-echo"

    config ECHO_WIFI_SSID
        string "Wi-Fi SSID (TCP)"
        default ""

    config ECHO_WIFI_PASSWORD
        string "Wi-Fi password (TCP)"
        default ""

    config ECHO_ESPNOW_PEER
        string "ESP-NOW peer MAC (aa:bb:cc:dd:ee:ff)"
        default "ff:ff:ff:ff:ff:ff"

    config ECHO_ESPNOW_CHANNEL
        int "ESP-NOW channel"
        default 1
        range 1 14

endmenu
```
